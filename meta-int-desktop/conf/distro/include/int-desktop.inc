## meta-int-desktop/conf/layer.conf
```bitbake
BBPATH .= ":${LAYERDIR}"
BBFILES += "${LAYERDIR}/recipes-*/*/*.bb ${LAYERDIR}/recipes-*/*/*.bbappend"
BBFILE_COLLECTIONS += "int-desktop"
BBFILE_PATTERN_int-desktop = "^${LAYERDIR}/"
BBFILE_PRIORITY_int-desktop = "7"
LAYERSERIES_COMPAT_int-desktop = "wrynose"
LAYERDEPENDS_int-desktop = "core int wayland openembedded-layer"
```
